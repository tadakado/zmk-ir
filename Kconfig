## Kconfig
```kconfig
# ============================================================================
#  IR TX -- NEC transmit behavior
# ============================================================================
config ZMK_BEHAVIOR_IR_TX
    bool "ZMK IR TX behavior (NEC)"
    default y
    depends on DT_HAS_ZMK_BEHAVIOR_IR_TX_ENABLED

config IR_TX_REPEAT_COUNT
    int "IR TX repeat count per key press"
    depends on ZMK_BEHAVIOR_IR_TX
    default 3
    range 1 10
    help
      Number of repeats sent for a single key press. With IR_TX_USE_REPEAT_CODE
      disabled (default) this is how many times the complete NEC frame is
      transmitted (each ~70ms frame + a ~58ms gap). With it enabled, it is how
      many NEC repeat codes follow the initial frame.

config IR_TX_USE_REPEAT_CODE
    bool "Send NEC repeat codes after the frame (held-button behaviour)"
    depends on ZMK_BEHAVIOR_IR_TX
    default n
    help
      When enabled, a key press sends IR_TX_FRAME_COUNT "sets", each being one
      full NEC frame followed by IR_TX_REPEAT_COUNT NEC "repeat" codes (9ms
      leader + 2.25ms space), the whole stream spaced at the standard ~108ms NEC
      period -- i.e. what a real remote sends while a button is held (with the
      frame re-asserted at the start of each set). When disabled (default), the
      full frame is simply sent IR_TX_REPEAT_COUNT times instead.

config IR_TX_FRAME_COUNT
    int "Number of frame+repeats sets per key press (repeat-code mode)"
    depends on IR_TX_USE_REPEAT_CODE
    default 1
    range 1 10
    help
      In repeat-code mode, how many times the (full frame + IR_TX_REPEAT_COUNT
      repeat codes) set is sent. 1 = one frame then repeats (plain held-button).
      >1 re-sends the full frame periodically for extra robustness, e.g. 5 sets
      of a frame + 5 repeats = 5 frames + 25 repeat codes.

config IR_TX_HW_PWM
    bool "Generate the NEC waveform with hardware PWM (nRF EasyDMA) instead of bit-bang"
    depends on ZMK_BEHAVIOR_IR_TX
    depends on HAS_NRFX
    select NRFX_PWM0
    default n
    help
      Play the NEC waveform from a RAM duty-cycle buffer via the nRF PWM
      peripheral's EasyDMA sequence, instead of CPU busy-wait bit-banging. The
      hardware clocks the carrier, so the waveform is immune to interrupt jitter
      (BLE radio etc.) and the CPU is free during the send. nRF-only; uses a
      ~7KB RAM buffer. The bit-bang path (default) stays as a portable reference.
      Drive the IR LED via IR_TX_HW_PWM_PIN, and do NOT also let Zephyr's PWM
      driver own PWM0 (nrfx owns it here) -- i.e. don't include the Zephyr
      pwm0/pwm-leds devicetree setup when this is enabled.

config IR_TX_HW_PWM_PIN
    int "IR LED pin for hardware PWM (nRF pin number = port*32 + pin)"
    depends on IR_TX_HW_PWM
    default 33
    help
      Raw nRF GPIO pin the PWM carrier drives. Examples: P1.01 = 33, P0.10 = 10.

config IR_TX_THREAD_STACK_SIZE
    int "IR TX dedicated work queue stack size"
    depends on ZMK_BEHAVIOR_IR_TX
    default 1024

config IR_TX_THREAD_PRIORITY
    int "IR TX dedicated work queue thread priority"
    depends on ZMK_BEHAVIOR_IR_TX
    default -1
    help
      The IR send bit-bangs the NEC envelope with busy-waits, so its timing must
      NOT be preempted by ordinary threads or the carrier mark/space lengths get
      stretched and the receiver can't decode the frame. Hence a cooperative
      (negative) priority. It runs on its OWN work queue (not the shared system
      one) so that during the k_sleep inter-frame gaps the system work queue is
      free to do other work. Only ISRs and higher cooperative threads (e.g. the
      BLE stack) interrupt it; lower-priority threads pause during each ~70ms
      frame and catch up in the gaps. A preemptible (>=0) priority makes the
      rest of the system more responsive but corrupts the IR waveform.

# ============================================================================
#  IR RX -- NEC receive + decode driver
# ============================================================================
menuconfig IR_RX
    bool "IR receiver (38kHz demodulated) capture + NEC decode"
    depends on DT_HAS_ZMK_IR_RX_ENABLED
    help
        Capture a 38kHz IR receiver's demodulated digital output (e.g.
        OSRB38C9AA) by timing its edges, decode the NEC32 frame used by the IR
        TX behavior (customer + data), and log the result. Useful for reading
        remote codes.

if IR_RX

config IR_RX_INIT_PRIORITY
    int "IR RX driver init priority"
    default 90

module = IR_RX
module-str = IR_RX
source "${ZEPHYR_BASE}/subsys/logging/Kconfig.template.log_config"

endif # IR_RX
```

## dts/bindings/behaviors/zmk,behavior-ir-tx.yaml
```yaml
description: NEC IR transmit behavior
compatible: "zmk,behavior-ir-tx"
include: two_param.yaml

properties:
  locality:
    type: string
    default: "global"
```

## dts/bindings/zmk,ir-rx.yaml
```yaml
description: 38kHz IR receiver (demodulated digital output) capture + NEC decoder

compatible: "zmk,ir-rx"

properties:
  in-gpios:
    type: phandle-array
    required: true
    description: |
      IR receiver demodulated output pin. The receiver idles high and pulls low
      while a 38kHz carrier is present (active low). Declared GPIO_ACTIVE_HIGH so
      the driver reads the raw physical level when timing edges.
```
